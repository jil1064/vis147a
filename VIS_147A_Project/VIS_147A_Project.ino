//Poem Related
int wordType = 1;
int tension = int(random(260));
float min = 0;
float max = 501;
int index1, index3;
String Nouns[10] = {"flower", "wind", "star", "river", "cloud", "moon", "rain", "dove", "house", "pasture"};
String Verbs[10] = {"glimpses", "gazes at", "whispers to", "chuckles at", "touches", "wanders with", "leaps with", "chases after", "strikes upon", "crushes against"};

//Joystick Related
int joyInXPin = A0; 
int joyInYPin = A1; 
int valX = 0;
int valY = 0;
int DEAD_ZONE = 5; 
int nullX = 510; 
int nullY = 504; 

void setup() {
  Serial.begin(9600);
  Serial.println();
}

void loop() {
  delay(1599); 
  valX = analogRead(joyInXPin);
  valY = analogRead(joyInYPin);
   if (valX > nullX && (valX - nullX) >= DEAD_ZONE) { //Up
      joy(valX - nullX);
   }
   if (valX < nullX && (nullX - valX) >= DEAD_ZONE) { //Down
      joy(nullX - valX);
   }
   if (valY < nullY && (nullY - valY) >= DEAD_ZONE) { //Left
      joy(nullY - valY);
   }
   if (valY > nullY && (valY - nullY) >= DEAD_ZONE) { //Right
      joy(valY - nullY);
   } 
  tension = int(random(260));
  printWord(tension);  
}

void joy(int moveAmt) { 
 moveAmt = constrain(moveAmt, 0, 500);
 printWord(moveAmt);
}

void printWord(int tens) {
  //Serial.println(tens);
  if (wordType == 1) {
    Serial.print("The ");
    wordType = 2;
  } else if (wordType == 2) {
    index1 = int(floor(random(0,10)));
    Serial.print(Nouns[index1]+" ");
    wordType = 3;
  } else if (wordType == 3) {
    Serial.print(Verbs[int(floor(tens/max*10))]+" ");
    wordType = 4;
  } else if (wordType == 4) {
    Serial.print("the ");
    wordType = 5;
  } else if (wordType == 5) {
    index3 = int(floor(random(0,10)));
    if (index3 == index1){index3 = int(floor(random(0,10)));}
    String noun = Nouns[index3];
    noun.toLowerCase();
    Serial.print(noun);
    Serial.println();
    Serial.println();
    wordType = 1;
  }
}